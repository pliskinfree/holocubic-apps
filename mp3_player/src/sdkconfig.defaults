## mp3_player/src/sdkconfig.defaults
```kconfig
CONFIG_ELF_LOADER=y
CONFIG_ELF_DYNAMIC_LOAD_SHARED_OBJECT=y
CONFIG_COMPILER_OPTIMIZATION_PERF=y
CONFIG_SPIRAM=y
CONFIG_SPIRAM_USE_MALLOC=y
CONFIG_DSP_OPTIMIZED=y
# 只注册 music app 需要的 MP3/WAV(PCM) 解码，避免把无关 codec 拉进 .so。
# CONFIG_AUDIO_DECODER_AAC_SUPPORT is not set
CONFIG_AUDIO_DECODER_MP3_SUPPORT=y
# CONFIG_AUDIO_DECODER_G711_SUPPORT is not set
# CONFIG_AUDIO_DECODER_AMRNB_SUPPORT is not set
# CONFIG_AUDIO_DECODER_AMRWB_SUPPORT is not set
# CONFIG_AUDIO_DECODER_FLAC_SUPPORT is not set
# CONFIG_AUDIO_DECODER_OPUS_SUPPORT is not set
# CONFIG_AUDIO_DECODER_VORBIS_SUPPORT is not set
# CONFIG_AUDIO_DECODER_ADPCM_SUPPORT is not set
# CONFIG_AUDIO_DECODER_ALAC_SUPPORT is not set
CONFIG_AUDIO_DECODER_PCM_SUPPORT=y
# CONFIG_AUDIO_DECODER_SBC_SUPPORT is not set
# CONFIG_AUDIO_DECODER_LC3_SUPPORT is not set
# CONFIG_AUDIO_DECODER_G722_SUPPORT is not set
CONFIG_AUDIO_SIMPLE_DEC_WAV_SUPPORT=y
# CONFIG_AUDIO_SIMPLE_DEC_M4A_SUPPORT is not set
# CONFIG_AUDIO_SIMPLE_DEC_TS_SUPPORT is not set
# CONFIG_AUDIO_SIMPLE_DEC_OGG_SUPPORT is not set
# CONFIG_AUDIO_ENCODER_AAC_SUPPORT is not set
# CONFIG_AUDIO_ENCODER_G711_SUPPORT is not set
# CONFIG_AUDIO_ENCODER_AMRNB_SUPPORT is not set
# CONFIG_AUDIO_ENCODER_AMRWB_SUPPORT is not set
# CONFIG_AUDIO_ENCODER_OPUS_SUPPORT is not set
# CONFIG_AUDIO_ENCODER_ADPCM_SUPPORT is not set
# CONFIG_AUDIO_ENCODER_ALAC_SUPPORT is not set
# CONFIG_AUDIO_ENCODER_PCM_SUPPORT is not set
# CONFIG_AUDIO_ENCODER_SBC_SUPPORT is not set
# CONFIG_AUDIO_ENCODER_LC3_SUPPORT is not set
# CONFIG_AUDIO_ENCODER_G722_SUPPORT is not set
```

## xiaozhi/src/sdkconfig.defaults
```kconfig
CONFIG_ELF_LOADER=y
CONFIG_ELF_DYNAMIC_LOAD_SHARED_OBJECT=y
CONFIG_COMPILER_OPTIMIZATION_PERF=y
# CONFIG_COMPILER_OPTIMIZATION_DEBUG is not set
```

## xiaozhi/src/wake/sdkconfig.defaults
```kconfig
CONFIG_MODEL_IN_SDCARD=y
# CONFIG_MODEL_IN_FLASH is not set
CONFIG_SR_WN_WN9S_NIHAOXIAOZHI=y
CONFIG_ELF_LOADER=y
CONFIG_ELF_DYNAMIC_LOAD_SHARED_OBJECT=y
```
